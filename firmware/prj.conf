## CMakeLists.txt
```
cmake_minimum_required(VERSION 3.20.0)
find_package(Zephyr REQUIRED HINTS $ENV{ZEPHYR_BASE})

project(watering_system)

target_sources(app PRIVATE src/main.c src/motor_control.c src/bluetooth.c src/plant_manager.c)
```

## prj.conf
```kconfig
#Peripherials 
CONFIG_GPIO=y

#USB / Termial
CONFIG_SERIAL=y
CONFIG_LOG=y

# Enable Bluetooth LE Peripheral role
CONFIG_BT=y
CONFIG_BT_PERIPHERAL=y

# Bluetooth device identity
CONFIG_BT_DEVICE_NAME="Watering Service"
 # Generic appearance
CONFIG_BT_DEVICE_APPEARANCE=0 
 # Only one central connected at a time
CONFIG_BT_MAX_CONN=1          

# Enable GATT service changed characteristic (good practice for custom services)
CONFIG_BT_GATT_SERVICE_CHANGED=y

# Add bonding support
CONFIG_BT_SMP=y
CONFIG_SETTINGS=y
CONFIG_BT_SETTINGS=y
CONFIG_FLASH=y
CONFIG_FLASH_PAGE_LAYOUT=y
CONFIG_FLASH_MAP=y
CONFIG_NVS=y
```

## boards/lp_em_cc2340r53.conf
```kconfig
# Add other TI-specific configs here
# Recommended from TI Github
#CONFIG_BT_RECV_WORKQ_SYS=y
#CONFIG_MCUMGR_TRANSPORT_NETBUF_COUNT=3
#CONFIG_MCUMGR_TRANSPORT_WORKQUEUE_STACK_SIZE=1536
#CONFIG_BT_BUF_EVT_RX_SIZE=68
#CONFIG_BT_BUF_ACL_RX_SIZE=69
#CONFIG_BT_BUF_ACL_TX_SIZE=27
#CONFIG_BT_BUF_CMD_TX_SIZE=65
```

## boards/xiao_ble_nrf52840_sense.conf
```kconfig
# Add other Nordic-specific configs here
CONFIG_BT_LL_SOFTDEVICE=y
```

## boards/lp_em_cc2340r53.overlay
```dts
/ {
	motor_switch: motor_switch {
		compatible = "power-switch";
		gpios = <&gpio0 14 GPIO_ACTIVE_HIGH>;
	};
};
```

## boards/nrf52840dk_nrf52840.overlay
```dts
/ {
	motor_switch: motor_switch {
		compatible = "power-switch";
		gpios = <&gpio0 29 GPIO_ACTIVE_HIGH>;
	};
};
```

## dts/bindings/power-switch.yaml
```yaml
# Copyright (c) 2023 Libre Solar Technologies GmbH
# SPDX-License-Identifier: Apache-2.0

description: GPIO pin to switch a power output on or off

compatible: "power-switch"

properties:
  gpios:
    type: phandle-array
    required: true
    description: |
      The GPIO connected to the relay.
```

## src/main.c
```c
#include "bluetooth.h"
#include "plant_manager.h"
#include <zephyr/kernel.h>
#include <zephyr/logging/log.h>

LOG_MODULE_REGISTER(main);

/* Default configuration */
static struct plant_config config = {
    .mode = PLANT_MODE_OFF, // Start in OFF mode
    .interval_min = 1,      // Default: water every hour
    .amount_ml = 100        // Default: 100ml per watering
};

/* System status */
static struct plant_status status = {
    .last_watered_seconds = 0, // Never watered
    .watering = false          // Not watering
};

int main(void)
{
    int err;

    LOG_INF("🌿 Smart Plant Watering System starting...");

    /* Initialize Bluetooth */
    err = bluetooth_init(&config, &status);
    if (err)
    {
        LOG_ERR("Failed to initialize Bluetooth (err %d)", err);
        return err;
    }
    LOG_INF("Bluetooth initialized successfully");

    /* Initialize Plant Manager */
    err = plant_manager_init(&config, &status);
    if (err)
    {
        LOG_ERR("Failed to initialize Plant Manager (err %d)", err);
        return err;
    }
    LOG_INF("Plant Manager initialized successfully");

    LOG_INF("System ready! Current mode: %s",
            config.mode == PLANT_MODE_OFF ? "OFF" : config.mode == PLANT_MODE_MANUAL ? "MANUAL"
                                                                                     : "SCHEDULED");

    /* Main loop */
    while (1)
    {
        plant_manager_tick();
        k_sleep(K_MSEC(500));
    }

    return 0;
}
```

## src/bluetooth.c
```c
#include "bluetooth.h"
#include "plant_common.h"

#include <zephyr/kernel.h>
#include <zephyr/sys/byteorder.h>
#include <zephyr/logging/log.h>
#include <zephyr/bluetooth/bluetooth.h>
#include <zephyr/bluetooth/uuid.h>
#include <zephyr/bluetooth/gatt.h>
#include <zephyr/bluetooth/hci.h>
#include <zephyr/settings/settings.h>

LOG_MODULE_REGISTER(watering_service, LOG_LEVEL_INF);

// Define 128-bit UUIDs for the custom service and its characteristics
#define BT_UUID_WATERING_SERVICE_VAL BT_UUID_128_ENCODE(0xDEAD0000, 0xC634, 0x45D2, 0xA209, 0xC636967B81B2)
#define BT_UUID_WATERING_MODE_VAL BT_UUID_128_ENCODE(0xDEAD0001, 0xC634, 0x45D2, 0xA209, 0xC636967B81B2)
#define BT_UUID_WATERING_INTERVAL_VAL BT_UUID_128_ENCODE(0xDEAD0002, 0xC634, 0x45D2, 0xA209, 0xC636967B81B2)
#define BT_UUID_WATERING_AMOUNT_VAL BT_UUID_128_ENCODE(0xDEAD0003, 0xC634, 0x45D2, 0xA209, 0xC636967B81B2)
#define BT_UUID_WATERING_NOW_VAL BT_UUID_128_ENCODE(0xDEAD0004, 0xC634, 0x45D2, 0xA209, 0xC636967B81B2)
#define BT_UUID_WATERING_STATUS_VAL BT_UUID_128_ENCODE(0xDEAD0005, 0xC634, 0x45D2, 0xA209, 0xC636967B81B2)
#define BT_UUID_WATERING_LAST_VAL BT_UUID_128_ENCODE(0xDEAD0006, 0xC634, 0x45D2, 0xA209, 0xC636967B81B2)
#define BT_UUID_WATERING_NEXT_VAL BT_UUID_128_ENCODE(0xDEAD0007, 0xC634, 0x45D2, 0xA209, 0xC636967B81B2)

#define BT_UUID_WATERING_SERVICE BT_UUID_DECLARE_128(BT_UUID_WATERING_SERVICE_VAL)
#define BT_UUID_WATERING_MODE BT_UUID_DECLARE_128(BT_UUID_WATERING_MODE_VAL)
#define BT_UUID_WATERING_INTERVAL BT_UUID_DECLARE_128(BT_UUID_WATERING_INTERVAL_VAL)
#define BT_UUID_WATERING_AMOUNT BT_UUID_DECLARE_128(BT_UUID_WATERING_AMOUNT_VAL)
#define BT_UUID_WATERING_NOW BT_UUID_DECLARE_128(BT_UUID_WATERING_NOW_VAL)
#define BT_UUID_WATERING_STATUS BT_UUID_DECLARE_128(BT_UUID_WATERING_STATUS_VAL)
#define BT_UUID_WATERING_LAST BT_UUID_DECLARE_128(BT_UUID_WATERING_LAST_VAL)
#define BT_UUID_WATERING_NEXT BT_UUID_DECLARE_128(BT_UUID_WATERING_NEXT_VAL)

static struct plant_config *cfg_ptr;
static struct plant_status *status_ptr;
static struct bt_conn *current_conn = NULL;

/* --- READ CALLBACKS --- */

static ssize_t read_mode(struct bt_conn *conn, const struct bt_gatt_attr *attr,
                         void *buf, uint16_t len, uint16_t offset)
{
    uint8_t mode = (uint8_t)cfg_ptr->mode;
    LOG_INF("Read: Mode = %u", mode);
    return bt_gatt_attr_read(conn, attr, buf, len, offset, &mode, sizeof(mode));
}

static ssize_t read_interval(struct bt_conn *conn, const struct bt_gatt_attr *attr,
                             void *buf, uint16_t len, uint16_t offset)
{
    LOG_INF("Read: Interval = %u", cfg_ptr->interval_min);
    return bt_gatt_attr_read(conn, attr, buf, len, offset, &cfg_ptr->interval_min, sizeof(cfg_ptr->interval_min));
}

static ssize_t read_amount(struct bt_conn *conn, const struct bt_gatt_attr *attr,
                           void *buf, uint16_t len, uint16_t offset)
{
    LOG_INF("Read: Amount = %u", cfg_ptr->amount_ml);
    return bt_gatt_attr_read(conn, attr, buf, len, offset, &cfg_ptr->amount_ml, sizeof(cfg_ptr->amount_ml));
}

static ssize_t read_status(struct bt_conn *conn, const struct bt_gatt_attr *attr,
                           void *buf, uint16_t len, uint16_t offset)
{
    uint8_t status = status_ptr->watering ? 1 : 0;
    LOG_INF("Read: Watering status = %u", status);
    return bt_gatt_attr_read(conn, attr, buf, len, offset, &status, sizeof(status));
}

static ssize_t read_last_watered(struct bt_conn *conn, const struct bt_gatt_attr *attr,
                                 void *buf, uint16_t len, uint16_t offset)
{
    uint32_t now = k_uptime_get_32() / 1000; // Convert to seconds
    uint32_t since_seconds = now - status_ptr->last_watered_seconds;
    LOG_INF("Read: Time since last watering = %u seconds", since_seconds);
    return bt_gatt_attr_read(conn, attr, buf, len, offset, &since_seconds, sizeof(since_seconds));
}

static ssize_t read_next_watered(struct bt_conn *conn, const struct bt_gatt_attr *attr,
                                 void *buf, uint16_t len, uint16_t offset)
{
    uint32_t now = k_uptime_get_32() / 1000; // Convert to seconds
    uint32_t next_seconds = status_ptr->next_watering_seconds;
    uint32_t time_until = next_seconds > now ? next_seconds - now : 0;
    LOG_INF("Read: Time until next watering = %u seconds", time_until);
    return bt_gatt_attr_read(conn, attr, buf, len, offset, &time_until, sizeof(time_until));
}

/* --- WRITE CALLBACKS --- */

static ssize_t write_mode(struct bt_conn *conn, const struct bt_gatt_attr *attr,
                          const void *buf, uint16_t len, uint16_t offset, uint8_t flags)
{
    if (offset != 0 || len != 1)
    {
        return BT_GATT_ERR(BT_ATT_ERR_INVALID_ATTRIBUTE_LEN);
    }

    uint8_t new_mode = *(const uint8_t *)buf;
    if (new_mode > PLANT_MODE_SCHEDULED)
    {
        return BT_GATT_ERR(BT_ATT_ERR_WRITE_REQ_REJECTED);
    }

    cfg_ptr->mode = (plant_mode_t)new_mode;
    LOG_INF("Write: Mode = %u", cfg_ptr->mode);
    return len;
}

static ssize_t write_interval(struct bt_conn *conn, const struct bt_gatt_attr *attr,
                              const void *buf, uint16_t len, uint16_t offset, uint8_t flags)
{
    if (offset != 0 || len != sizeof(cfg_ptr->interval_min))
    {
        return BT_GATT_ERR(BT_ATT_ERR_INVALID_ATTRIBUTE_LEN);
    }
    cfg_ptr->interval_min = sys_get_le16(buf);
    LOG_INF("Write: Interval = %u min", cfg_ptr->interval_min);
    return len;
}

static ssize_t write_amount(struct bt_conn *conn, const struct bt_gatt_attr *attr,
                            const void *buf, uint16_t len, uint16_t offset, uint8_t flags)
{
    if (offset != 0 || len != sizeof(cfg_ptr->amount_ml))
    {
        return BT_GATT_ERR(BT_ATT_ERR_INVALID_ATTRIBUTE_LEN);
    }
    cfg_ptr->amount_ml = sys_get_le16(buf);
    LOG_INF("Write: Amount = %u ml", cfg_ptr->amount_ml);
    return len;
}

static ssize_t write_water_now(struct bt_conn *conn, const struct bt_gatt_attr *attr,
                               const void *buf, uint16_t len, uint16_t offset, uint8_t flags)
{
    if (offset != 0 || len != 1)
    {
        return BT_GATT_ERR(BT_ATT_ERR_INVALID_ATTRIBUTE_LEN);
    }

    uint8_t trigger = *(const uint8_t *)buf;
    if (trigger == 1)
    {
        LOG_INF("Manual watering triggered");
        cfg_ptr->water_now = true;
    }
    return len;
}

/* --- NOTIFICATION HANDLING --- */

static void status_ccc_cfg_changed(const struct bt_gatt_attr *attr, uint16_t value)
{
    bool notif_enabled = (value == BT_GATT_CCC_NOTIFY);
    LOG_INF("Watering status notifications %s", notif_enabled ? "enabled" : "disabled");
}

static void last_watered_ccc_cfg_changed(const struct bt_gatt_attr *attr, uint16_t value)
{
    bool notif_enabled = (value == BT_GATT_CCC_NOTIFY);
    LOG_INF("Last watered notifications %s", notif_enabled ? "enabled" : "disabled");
}

static void next_watered_ccc_cfg_changed(const struct bt_gatt_attr *attr, uint16_t value)
{
    bool notif_enabled = (value == BT_GATT_CCC_NOTIFY);
    LOG_INF("Next watered notifications %s", notif_enabled ? "enabled" : "disabled");
}

void notify_clients(const struct bt_gatt_attr *attr, const void *data, uint16_t len)
{
    if (!current_conn)
    {
        LOG_INF("No notification sent - no active connection");
        return;
    }

    const char *char_name = "unknown";
    const struct bt_gatt_attr *notify_attr = NULL;

    // Determine which characteristic we're notifying
    if (attr == &watering_svc.attrs[WATERING_STATUS_ATTR_POS])
    {
        notify_attr = &watering_svc.attrs[WATERING_STATUS_ATTR_POS];
        char_name = "watering status";
    }
    else if (attr == &watering_svc.attrs[LAST_WATERED_ATTR_POS])
    {
        notify_attr = &watering_svc.attrs[LAST_WATERED_ATTR_POS];
        char_name = "last watered";
    }
    else if (attr == &watering_svc.attrs[NEXT_WATERING_ATTR_POS])
    {
        notify_attr = &watering_svc.attrs[NEXT_WATERING_ATTR_POS];
        char_name = "next watering";
    }

    if (!notify_attr)
    {
        LOG_ERR("Invalid attribute for notification");
        return;
    }

    // Check if client is subscribed
    if (!bt_gatt_is_subscribed(current_conn, notify_attr, BT_GATT_CCC_NOTIFY))
    {
        LOG_INF("Client not subscribed for %s notifications", char_name);
        return;
    }

    // Send notification
    LOG_INF("Sending notification for %s", char_name);
    int err = bt_gatt_notify(current_conn, notify_attr, data, len);
    if (err)
    {
        LOG_ERR("Failed to send notification for %s (err %d)", char_name, err);
    }
}

/* --- GATT SERVICE DEFINITION --- */

BT_GATT_SERVICE_DEFINE(watering_svc,
                       BT_GATT_PRIMARY_SERVICE(BT_UUID_WATERING_SERVICE),

                       BT_GATT_CHARACTERISTIC(BT_UUID_WATERING_MODE,
                                              BT_GATT_CHRC_READ | BT_GATT_CHRC_WRITE,
                                              BT_GATT_PERM_READ | BT_GATT_PERM_WRITE_AUTHEN,
                                              read_mode, write_mode, NULL),

                       BT_GATT_CHARACTERISTIC(BT_UUID_WATERING_INTERVAL,
                                              BT_GATT_CHRC_READ | BT_GATT_CHRC_WRITE,
                                              BT_GATT_PERM_READ | BT_GATT_PERM_WRITE_AUTHEN,
                                              read_interval, write_interval, NULL),

                       BT_GATT_CHARACTERISTIC(BT_UUID_WATERING_AMOUNT,
                                              BT_GATT_CHRC_READ | BT_GATT_CHRC_WRITE,
                                              BT_GATT_PERM_READ | BT_GATT_PERM_WRITE_AUTHEN,
                                              read_amount, write_amount, NULL),

                       BT_GATT_CHARACTERISTIC(BT_UUID_WATERING_NOW,
                                              BT_GATT_CHRC_WRITE,
                                              BT_GATT_PERM_WRITE_AUTHEN,
                                              NULL, write_water_now, NULL),

                       BT_GATT_CHARACTERISTIC(BT_UUID_WATERING_STATUS,
                                              BT_GATT_CHRC_READ | BT_GATT_CHRC_NOTIFY,
                                              BT_GATT_PERM_READ,
                                              read_status, NULL, NULL),

                       BT_GATT_CCC(status_ccc_cfg_changed,
                                   BT_GATT_PERM_READ | BT_GATT_PERM_WRITE_AUTHEN),

                       BT_GATT_CHARACTERISTIC(BT_UUID_WATERING_LAST,
                                              BT_GATT_CHRC_READ | BT_GATT_CHRC_NOTIFY,
                                              BT_GATT_PERM_READ,
                                              read_last_watered, NULL, NULL),

                       BT_GATT_CCC(last_watered_ccc_cfg_changed,
                                   BT_GATT_PERM_READ | BT_GATT_PERM_WRITE_AUTHEN),

                       BT_GATT_CHARACTERISTIC(BT_UUID_WATERING_NEXT,
                                              BT_GATT_CHRC_READ | BT_GATT_CHRC_NOTIFY,
                                              BT_GATT_PERM_READ,
                                              read_next_watered, NULL, NULL),

                       BT_GATT_CCC(next_watered_ccc_cfg_changed,
                                   BT_GATT_PERM_READ | BT_GATT_PERM_WRITE_AUTHEN));

/* --- CONNECTION HANDLING --- */
static int start_advertising()
{
    const struct bt_data ad[] = {
        BT_DATA_BYTES(BT_DATA_FLAGS, (BT_LE_AD_GENERAL | BT_LE_AD_NO_BREDR)),
        BT_DATA(BT_DATA_NAME_COMPLETE, CONFIG_BT_DEVICE_NAME, sizeof(CONFIG_BT_DEVICE_NAME) - 1)};

    const struct bt_data sd[] = {
        BT_DATA_BYTES(BT_DATA_UUID128_ALL, BT_UUID_WATERING_SERVICE_VAL)};

    int err = bt_le_adv_start(BT_LE_ADV_CONN, ad, ARRAY_SIZE(ad), sd, ARRAY_SIZE(sd));
    if (err)
    {
        LOG_ERR("Advertising start failed (err %d)", err);
        return err;
    }

    LOG_INF("Advertising started (device name: \"%s\")", CONFIG_BT_DEVICE_NAME);
    return 0;
}

static void connected(struct bt_conn *conn, uint8_t err)
{
    if (err)
    {
        LOG_ERR("Connection failed (err %u)", err);
        return;
    }

    LOG_INF("Bluetooth central connected");
    current_conn = conn;
}

static void disconnected(struct bt_conn *conn, uint8_t reason)
{
    LOG_INF("Bluetooth disconnected (reason %u)", reason);
    current_conn = NULL;
    start_advertising();
}

static void on_security_changed(struct bt_conn *conn, bt_security_t level,
			     enum bt_security_err err)
{
	char addr[BT_ADDR_LE_STR_LEN];

	bt_addr_le_to_str(bt_conn_get_dst(conn), addr, sizeof(addr));

    if (err)
    {
        LOG_ERR("Security failed: %s level %u err %d", addr, level, err);
        return;
    }

    LOG_INF("Security changed: %s level %u", addr, level);
}

BT_CONN_CB_DEFINE(conn_cb) = {
    .connected = connected,
    .disconnected = disconnected,
    .security_changed = on_security_changed,
};

/* --- AUTHENTICATION HANDLING --- */
static void auth_passkey_display(struct bt_conn *conn, unsigned int passkey)
{
	char addr[BT_ADDR_LE_STR_LEN];

	bt_addr_le_to_str(bt_conn_get_dst(conn), addr, sizeof(addr));

	LOG_INF("Passkey for %s: %06u", addr, passkey);
}

static void auth_cancel(struct bt_conn *conn)
{
	char addr[BT_ADDR_LE_STR_LEN];

	bt_addr_le_to_str(bt_conn_get_dst(conn), addr, sizeof(addr));

	LOG_INF("Pairing cancelled: %s", addr);
}

static struct bt_conn_auth_cb conn_auth_callbacks = {
	.passkey_display = auth_passkey_display,
	.cancel = auth_cancel,
};

/* --- INIT FUNCTION --- */

int bluetooth_init(struct plant_config *config, struct plant_status *status)
{
    cfg_ptr = config;
    status_ptr = status;

    LOG_INF("Watering Service starting...");

    int err = bt_conn_auth_cb_register(&conn_auth_callbacks);
	if (err) {
		LOG_INF("Failed to register authorization callbacks");
		return err;
	}

    err = bt_enable(NULL);
    if (err)
    {
        LOG_ERR("Bluetooth init failed (err %d)", err);
        return err;
    }

    LOG_INF("Bluetooth initialized");

    /* Restore previous bonds after reboot */
    settings_load();

    start_advertising();

    k_sleep(K_SECONDS(10));

    return 0;
}
```

## src/bluetooth.h
```c
#ifndef BLUETOOTH_H
#define BLUETOOTH_H
#include "plant_common.h"
#include <zephyr/bluetooth/gatt.h>

// Forward declaration of the GATT service
extern const struct bt_gatt_service_static watering_svc;

/* Attribute positions in the GATT service:
 * Service layout:
 * 0: Service declaration
 * 1: Mode characteristic declaration
 * 2: Mode value
 * 3: Interval characteristic declaration
 * 4: Interval value
 * 5: Amount characteristic declaration
 * 6: Amount value
 * 7: Water Now characteristic declaration
 * 8: Water Now value
 * 9: Status characteristic declaration
 * 10: Status value (WATERING_STATUS_ATTR_POS)
 * 11: Status CCC
 * 12: Last Watered characteristic declaration
 * 13: Last Watered value (LAST_WATERED_ATTR_POS)
 * 14: Last Watered CCC
 * 15: Next Watering characteristic declaration
 * 16: Next Watering value (NEXT_WATERING_ATTR_POS)
 * 17: Next Watering CCC
 */
enum watering_char_position
{
    WATERING_STATUS_ATTR_POS = 10, // Status characteristic value
    LAST_WATERED_ATTR_POS = 13,    // Last watered characteristic value
    NEXT_WATERING_ATTR_POS = 16    // Next watering characteristic value
};

// Function to notify clients about characteristic changes
void notify_clients(const struct bt_gatt_attr *attr, const void *data, uint16_t len);

/**
 * @brief Initialize Bluetooth and register services
 *
 * @param config Pointer to plant configuration
 * @param status Pointer to plant status
 * @return 0 on success, negative error code on failure
 */
int bluetooth_init(struct plant_config *config, struct plant_status *status);

#endif /* BLUETOOTH_H */
```

## src/motor_control.c
```c
#include "motor_control.h"
#include <zephyr/kernel.h>
#include <zephyr/logging/log.h>
#include <zephyr/drivers/gpio.h>

LOG_MODULE_REGISTER(motor_control, LOG_LEVEL_INF);

#if !DT_NODE_EXISTS(DT_NODELABEL(motor_switch))
#error "Overlay for motor output node not properly defined."
#endif

static const struct gpio_dt_spec motor_switch =
	GPIO_DT_SPEC_GET_OR(DT_NODELABEL(motor_switch), gpios, {0});
static struct k_timer motor_timer;
static bool is_running = false;

/* Internal helper function to control motor state */
static int motor_set_state(bool enabled)
{
    if (is_running == enabled)
    {
        return 0;
    }

    int err = gpio_pin_set_dt(&motor_switch, enabled);
    if (err)
    {
        LOG_ERR("Failed to set motor state (err %d)", err);
        return err;
    }

    is_running = enabled;
    LOG_INF("Motor %s", enabled ? "enabled" : "disabled");
    return 0;
}

/* Timer callback for automatic motor stop */
static void motor_timeout(struct k_timer *timer_id)
{
    LOG_INF("Motor timeout – stopping");
    motor_control_stop();
}

int motor_control_init(void)
{
    int err;

    /* Check if GPIO device is ready */
    if (!gpio_is_ready_dt(&motor_switch))
    {
        LOG_ERR("GPIO device not ready");
        return -ENODEV;
    }

    /* Initialize motor timer */
    k_timer_init(&motor_timer, motor_timeout, NULL);

    /* Configure motor GPIO */
    err = gpio_pin_configure_dt(&motor_switch, GPIO_OUTPUT | GPIO_ACTIVE_HIGH);
    if (err)
    {
        LOG_ERR("Failed to configure motor GPIO (err %d)", err);
        return err;
    }

    /* Ensure motor is off */
    return motor_control_stop();
}

int motor_control_start(uint32_t duration_ms)
{
    int err;

    if (is_running)
    {
        LOG_WRN("Motor already running");
        return -EBUSY;
    }

    LOG_INF("Starting motor for %u ms", duration_ms);

    /* Start motor */
    err = motor_set_state(true);
    if (err)
    {
        return err;
    }

    /* Start timer for automatic stop */
    k_timer_start(&motor_timer, K_MSEC(duration_ms), K_NO_WAIT);
    return 0;
}

int motor_control_stop(void)
{
    int err;

    if (!is_running)
    {
        return 0;
    }

    /* Stop timer */
    k_timer_stop(&motor_timer);

    /* Turn off motor */
    err = motor_set_state(false);
    if (err)
    {
        LOG_ERR("Failed to stop motor (err %d)", err);
        return err;
    }

    return 0;
}

bool motor_control_is_running(void)
{
    return is_running;
}
```

## src/plant_common.h
```c
#ifndef PLANT_COMMON_H
#define PLANT_COMMON_H

#include <stdint.h>
#include <stdbool.h>

/**
 * @brief Plant watering modes
 *
 * OFF: No watering occurs
 * MANUAL: Watering can be triggered via BLE
 * SCHEDULED: Automatic watering based on interval
 */
typedef enum
{
    PLANT_MODE_OFF = 0,
    PLANT_MODE_MANUAL = 1,
    PLANT_MODE_SCHEDULED = 2,
} plant_mode_t;

/**
 * @brief Plant watering configuration
 */
struct plant_config
{
    plant_mode_t mode;     ///< Operating mode (OFF/MANUAL/SCHEDULED)
    uint16_t interval_min; ///< Watering interval in minutes
    uint16_t amount_ml;    ///< Watering amount in milliliters
    bool water_now;        ///< Flag to trigger immediate watering
};

/**
 * @brief Plant watering status
 */
struct plant_status
{
    uint32_t last_watered_seconds;  ///< Time since last watering in seconds
    uint32_t next_watering_seconds; ///< Time until next scheduled watering in seconds
    bool watering;                  ///< Whether watering is currently in progress
};

#endif /* PLANT_COMMON_H */
```

## src/plant_manager.c
```c
#include "plant_manager.h"
#include "motor_control.h"
#include "bluetooth.h"
#include <zephyr/kernel.h>
#include <zephyr/logging/log.h>
#include <zephyr/bluetooth/gatt.h>

LOG_MODULE_REGISTER(plant_manager);

static struct plant_config *cfg;
static struct plant_status *stat;

static struct k_work_delayable plant_work;

// Notify BLE clients about watering status change
static void notify_watering_status(void)
{
    uint8_t status = stat->watering ? 1 : 0;
    LOG_INF("Notifying watering status: %u", status);
    notify_clients(&watering_svc.attrs[WATERING_STATUS_ATTR_POS], &status, sizeof(status));
}

// Notify BLE clients about last watered time
static void notify_last_watered(void)
{
    uint32_t now = k_uptime_get_32() / 1000; // Convert to seconds
    uint32_t since_seconds = now - stat->last_watered_seconds;
    LOG_INF("Notifying last watered: %u seconds ago", since_seconds);
    notify_clients(&watering_svc.attrs[LAST_WATERED_ATTR_POS], &since_seconds, sizeof(since_seconds));
}

// Notify BLE clients about next watering time
static void notify_next_watering(void)
{
    uint32_t now = k_uptime_get_32() / 1000; // Convert to seconds
    uint32_t next_seconds = stat->next_watering_seconds;
    uint32_t time_until = next_seconds > now ? next_seconds - now : 0;
    LOG_INF("Notifying next watering: %u seconds from now", time_until);
    notify_clients(&watering_svc.attrs[NEXT_WATERING_ATTR_POS], &time_until, sizeof(time_until));
}

/**
 * Compute the pump-on time (in milliseconds) for a given volume (in mL).
 * Piecewise flow rate:
 *   • 0 ≤ volume ≤ 100 mL → 25 mL/s
 *   •       volume > 100 mL → 35 mL/s
 *
 * @param volume_ml  Desired volume in milliliters.
 * @return           Time in milliseconds
 */
static uint32_t pump_time_ms(uint32_t volume_ml)
{
    const uint32_t FLOW_RATE_LOW = 25;  // mL/s for volumes <= 100mL
    const uint32_t FLOW_RATE_HIGH = 35; // mL/s for volumes > 100mL
    const uint32_t THRESHOLD = 100;     // mL threshold between flow rates

    uint32_t rate = (volume_ml <= THRESHOLD) ? FLOW_RATE_LOW : FLOW_RATE_HIGH;

    return (volume_ml * 1000) / rate; // Convert to milliseconds
}

// Watering task
static void perform_watering(struct k_work *work)
{
    if (motor_control_is_running())
    {
        LOG_WRN("Watering already in progress");
        return;
    }

    LOG_INF("Starting watering cycle: %u ml", cfg->amount_ml);

    // Calculate watering duration (25ml per second)
    uint32_t duration_ms = pump_time_ms(cfg->amount_ml);
    int err = motor_control_start(duration_ms);
    if (err)
    {
        LOG_ERR("Failed to start watering (err %d)", err);
        return;
    }

    // Update status and notify
    stat->last_watered_seconds = k_uptime_get_32() / 1000; // Convert to seconds
    stat->watering = true;
    notify_watering_status();
    notify_last_watered();

    // Schedule next watering if in scheduled mode
    if (cfg->mode == PLANT_MODE_SCHEDULED)
    {
        uint32_t now = k_uptime_get_32() / 1000;
        stat->next_watering_seconds = now + (cfg->interval_min * 60);
        LOG_INF("Next watering scheduled in %u minutes", cfg->interval_min);
        k_work_reschedule(&plant_work, K_MINUTES(cfg->interval_min));
        notify_next_watering();
    }
}

// Initialization function
int plant_manager_init(struct plant_config *config, struct plant_status *status)
{
    int err;

    cfg = config;
    stat = status;

    err = motor_control_init();
    if (err)
    {
        LOG_ERR("Motor control init failed (err %d)", err);
        return err;
    }

    k_work_init_delayable(&plant_work, perform_watering);

    // Initialize with OFF mode
    cfg->mode = PLANT_MODE_OFF;
    cfg->water_now = false;
    return 0;
}

// Periodic tick function
void plant_manager_tick(void)
{
    static plant_mode_t last_mode = PLANT_MODE_OFF;
    static bool was_watering = false;
    static uint16_t last_interval = 0;

    notify_last_watered();
    notify_next_watering();

    // Update watering status based on motor state
    bool is_watering = motor_control_is_running();
    if (is_watering != was_watering)
    {
        LOG_INF("Watering state changed: %d -> %d", was_watering, is_watering);
        stat->watering = is_watering;
        was_watering = is_watering;
        notify_watering_status();
    }

    // Handle mode transition
    if (cfg->mode != last_mode)
    {
        LOG_INF("Switching from mode %d to mode %d", last_mode, cfg->mode);

        // Cancel any scheduled watering
        k_work_cancel_delayable(&plant_work);

        // Stop motor if running
        if (stat->watering)
        {
            motor_control_stop();
        }

        // Schedule next watering if in scheduled mode
        if (cfg->mode == PLANT_MODE_SCHEDULED)
        {
            uint32_t now = k_uptime_get_32() / 1000;
            stat->next_watering_seconds = now + (cfg->interval_min * 60);
            LOG_INF("Scheduling watering in %u minutes", cfg->interval_min);
            k_work_schedule(&plant_work, K_MINUTES(cfg->interval_min));
            notify_next_watering();
        }

        last_mode = cfg->mode;
        last_interval = cfg->interval_min;
    }

    // Handle interval change in scheduled mode
    if (cfg->mode == PLANT_MODE_SCHEDULED && cfg->interval_min != last_interval)
    {
        LOG_INF("Interval changed from %u to %u minutes", last_interval, cfg->interval_min);

        // Cancel current schedule
        k_work_cancel_delayable(&plant_work);

        // Reschedule with new interval
        uint32_t now = k_uptime_get_32() / 1000;
        stat->next_watering_seconds = now + (cfg->interval_min * 60);
        k_work_schedule(&plant_work, K_MINUTES(cfg->interval_min));
        notify_next_watering();

        last_interval = cfg->interval_min;
    }

    // Handle manual watering trigger
    if (cfg->mode == PLANT_MODE_MANUAL && cfg->water_now && !stat->watering)
    {
        perform_watering(NULL);
        cfg->water_now = false; // Clear the trigger after use
    }
}
```

## src/plant_manager.h
```c
#ifndef PLANT_MANAGER_H
#define PLANT_MANAGER_H

#include "plant_common.h"

/**
 * @brief Initialize plant manager and schedule periodic watering
 *
 * @param config Pointer to plant configuration
 * @param status Pointer to plant status
 * @return 0 on success, negative error code on failure
 */
int plant_manager_init(struct plant_config *config, struct plant_status *status);

/**
 * @brief Call periodically to check and act on watering needs
 *
 * This function should be called in the main loop to handle:
 * - Mode transitions
 * - Manual watering triggers
 * - Scheduled watering
 */
void plant_manager_tick(void);

#endif /* PLANT_MANAGER_H */
```
